## br-ext/package/fastrpc_ext/Config.in
```kconfig
config BR2_PACKAGE_FASTRPC_EXT
	bool "fastrpc"
	select BR2_PACKAGE_LIBYAML
	select BR2_PACKAGE_LIBBSD
	help
	  Qualcomm FastRPC userspace library and the fastrpc_test
	  validation tool. fastrpc_test exercises CPU<->DSP remote
	  procedure calls by loading a payload onto a coprocessor
	  (e.g. the CDSP), running it and checking the response.

	  Used here to validate the OP-TEE PAS (Peripheral Authentication
	  Service) coprocessor load/reset sequences: a passing run proves
	  OP-TEE brought the coprocessor up correctly.

	  https://github.com/qualcomm/fastrpc
```

## br-ext/package/qrtr_ext/Config.in
```kconfig
config BR2_PACKAGE_QRTR_EXT
	bool "qrtr"
	help
	  Qualcomm IPC Router (QRTR) userspace: libqrtr and the
	  qrtr-ns name service daemon (plus qrtr-cfg, qrtr-lookup).

	  qrtr-ns provides QMI service discovery, required for the DSP
	  subsystems to register their protection-domain "servreg"
	  service. Without it the DSP rootPD never finishes coming up
	  and FastRPC stalls with a GLINK intent timeout.

	  https://github.com/linux-msm/qrtr
```

## br-ext/package/tqftpserv_ext/Config.in
```kconfig
config BR2_PACKAGE_TQFTPSERV_EXT
	bool "tqftpserv"
	select BR2_PACKAGE_QRTR_EXT
	select BR2_PACKAGE_ZSTD
	help
	  TFTP-over-QRTR file server (tqftpserv). Qualcomm DSP firmware
	  reads files from the apps root filesystem over QRTR via this
	  server; the CDSP FastRPC rootPD needs it to load its runtime.
	  Without it the fastrpc GLINK channel opens but the DSP never
	  services it (GLINK intent timeout).

	  https://github.com/linux-msm/tqftpserv
```
